## CMakeLists.txt
```
cmake_minimum_required(VERSION 3.20.0)

find_package(Zephyr REQUIRED HINTS $ENV{ZEPHYR_BASE})

project(adc_potentiometer)

target_sources(app PRIVATE src/main.c)
```

## prj.conf
```kconfig
CONFIG_ADC=y
CONFIG_LOG=y
CONFIG_LOG_MODE_IMMEDIATE=y
```

## boards/nrf52840dk_nrf52840.overlay
```dts
/ {
    zephyr,user {
        io-channels = <&adc0 0>; // creating c ref 2 dev adc0 chann 0
    };
};

&adc0 {
    #address-cells = <1>; // addressing by only 1 num
    #size-cells = <0>; // size of 0 because channels arent memory mapped
    status = "okay";

    channel@0 {
        reg = <0>; // reg is the channel number
        zephyr,gain = "ADC_GAIN_1_6";	// gain of 1/6 for the ADC
        zephyr,reference = "ADC_REF_INTERNAL";
        zephyr,acquisition-time = <ADC_ACQ_TIME_DEFAULT>;
        zephyr,input-positive = <NRF_SAADC_AIN0>;
        zephyr,resolution = <12>;
    };
};
```

## src/main.c
```c
#include <zephyr/kernel.h>
#include <zephyr/device.h>
#include <zephyr/drivers/adc.h>
#include <zephyr/sys/printk.h>

static const struct adc_dt_spec adc = ADC_DT_SPEC_GET_BY_IDX(DT_PATH(zephyr_user), 0);

int main(void) {
    if (!adc_is_ready_dt(&adc)) {
        printk("adc device not ready\n");

        return -1;
    }

    adc_channel_setup_dt(&adc);
    int16_t sample_buf;
    
    // sequence is contains buff & buff size 4 the adc read
    struct adc_sequence sequence = { 
        .buffer = &sample_buf, // writing adc read val 2 sample_buf variable type shit...
        .buffer_size = sizeof sample_buf,
    };

    // init sequence with adc device
    adc_sequence_init_dt(&adc, &sequence);

    for (;;) {
        const int rc = adc_read_dt(&adc, &sequence);

        if (rc == 0) {
            int32_t mv = sample_buf;
            adc_raw_to_millivolts_dt(&adc, &mv); // stores the converted value in mv variable
            printk("raw val = %d, mv = %d\n", sample_buf, mv);
        } else {
            printk("adc_read_dt failed: %d\n", rc);
        }

        k_msleep(200);
    }

    return 0;
}
```
